## esp32/main/Kconfig.projbuild
```kconfig
menu "NoiseGuard - Configuracao de Hardware"

    config NG_CONFIG_BUTTON_GPIO
        int "GPIO do botao de configuracao (ativo em zero)"
        default 4
        range 0 39
        help
            GPIO ligado ao botao que entra no modo de configuracao.
            O botao deve ligar o pino ao GND (ativo em zero). O pull-up
            interno e habilitado automaticamente.
            EVITE GPIO0: nivel baixo no boot coloca a ROM em modo download.

    config NG_STATUS_LED_GPIO
        int "GPIO do LED de status (primario)"
        default 0
        range 0 39
        help
            GPIO que aciona o LED de status. O LED acende em nivel alto
            (anodo no GPIO, catodo no GND atraves de um resistor).
            Padroes de piscada indicam o modo (config x normal).

    config NG_STATUS_LED_GPIO2
        int "GPIO do LED de status (secundario)"
        default 2
        range 0 39
        help
            Segundo GPIO acionado em paralelo com o primario, com exatamente
            o mesmo padrao de piscada. Use -1 para desabilitar o secundario.

    config NG_ADC_CHANNEL
        int "Canal ADC1 do sensor analogico"
        default 6
        range 0 7
        help
            Canal do ADC1 onde o sinal analogico (microfone) esta ligado.
            Canal 6 = GPIO34 (entrada apenas, ideal para sensor).
            Tabela: 0=GPIO36 1=GPIO37 2=GPIO38 3=GPIO39 4=GPIO32
            5=GPIO33 6=GPIO34 7=GPIO35

    config NG_AP_SSID
        string "Prefixo do SSID do AP no modo de configuracao"
        default "NoiseGuard"
        help
            Prefixo do nome da rede criada no modo de configuracao.
            O SSID final fica "<prefixo>_XXXXXX", onde XXXXXX sao os 6
            ultimos digitos hex do MAC da WiFi (ex.: NoiseGuard_A1B2C3).

    config NG_AP_PASSWORD
        string "Senha do AP no modo de configuracao (>=8 chars, vazio = aberto)"
        default "noiseguard"

    config NG_DEFAULT_SERVER_HOST
        string "Host/IP padrao do servidor"
        default "192.168.0.100"

    config NG_DEFAULT_SERVER_PORT
        int "Porta padrao do servidor"
        default 3000

    config NG_DEFAULT_SERVER_PATH
        string "Caminho (endpoint) padrao no servidor"
        default "/api/noise"

    config NG_DEFAULT_DEVICE_ID
        int "Device ID padrao"
        default 10034

    config NG_DEFAULT_INTERVAL_MS
        int "Intervalo de envio padrao (ms)"
        default 500

    config NG_DEFAULT_NTP_INTERVAL_S
        int "Intervalo de resync NTP padrao (s)"
        default 3600
        help
            De quanto em quanto tempo o relogio e re-sincronizado via NTP.
            Minimo efetivo de 15s (imposto pelo lwip).

endmenu
```
